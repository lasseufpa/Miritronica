#include <PCM.h>
const unsigned char miritronica_som[] PROGMEM = {
  126, 127, 127, 127, 127, 128, 128, 128, 127, 128, 127, 128,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 123,
};

const unsigned char egua_som[] PROGMEM = {
  126, 126, 127, 127, 127, 127, 127, 127, 127, 127, 127, 127,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 126,
};

//Include da biblioteca dos servos motores

//Declaração dos objetos do tipo Servo que controlarão os motores

#define braco1 6
#define braco2 7
#define cabeca 8

void servo0graus();
void servo90graus();
void servo180graus();

//Declaração do pino do sensor ultrassônico
short sensor = 12;

//Pinos dos vermelhos, do azul e do verde das LEDs RGB
short v = 2;
short r = 4;
short b = 3;
short g = 5;
short p = 0;
boolean stat = true;
void setup() {
  //Definição de tipo de pino das LEDs e do pino de comunicação com o segundo arduino (todos saída/escrita)
  pinMode(g, OUTPUT);
  pinMode(r, OUTPUT);
  pinMode(b, OUTPUT);
  pinMode(v, OUTPUT);

  //Definição de qual pino cada objeto Servo irá controlar
}

void loop() {
  //Liga os pinos azul e verde das LEDs
  digitalWrite(g, LOW);
  digitalWrite(b, LOW);

  //Ativa o gatilho do sensor que manda uma onda ultrassônica e lê a quantidade de microssegundos que a onda demorou para ir e voltar
  long tempo, cm;
  pinMode(sensor, OUTPUT);
  digitalWrite(sensor, LOW);
  delayMicroseconds(10);
  digitalWrite(sensor, HIGH);
  delayMicroseconds(10);
  digitalWrite(sensor, LOW);
  pinMode(sensor, INPUT);
  tempo = pulseIn(sensor, HIGH);

  //Transforma a quantidade de tempo que a onda demorou em seu trajeto em distância (centímetros)
  cm = microsecondsToCentimeters(tempo);

  //Checa se o obstáculo mais próximo está a pelo menos 15 centímetros
  if ( cm < 15 && cm != 0 ) {

    egua();
    //Desliga as LEDs azul e verde
    digitalWrite(g, HIGH);
    digitalWrite(b, HIGH);
    for (char i = 0; i < 100; i++) {
      servo90graus();
      if (i % 5 == 0) {
        digitalWrite(v, stat);
        digitalWrite(r, stat);
        stat = !(stat);
      }
    }
    for (char i = 0; i < 100; i++) {
      servo0graus();
      if (i % 5 == 0) {
        digitalWrite(v, stat);
        digitalWrite(r, stat);
        stat = !(stat);
      }
    }
    miritronica();
  }

}

//Função responsável por transformar o tempo de viagem da onda em centímetros
long microsecondsToCentimeters(long microseconds) {
  return microseconds /  29 / 2;
}

void miritronica()
{
  startPlayback(miritronica_som, sizeof(miritronica_som));
}

//Função responsável por tocar o áudio "miritrônica"
void egua()
{
  startPlayback(egua_som, sizeof(egua_som));
}

void servo0graus()              //Posiciona o servo em 0 graus
{
  digitalWrite(braco1, HIGH);  //pulso do servo
  digitalWrite(braco2, HIGH);
  delayMicroseconds(600);      //0.6ms
  digitalWrite(braco1, LOW);
  digitalWrite(braco2, LOW);//completa periodo do servo
  for (int i = 0; i < 32; i++)delayMicroseconds(600);
  // 20ms = 20000us
  // 20000us - 600us = 19400us
  // 19400/600 = ~~32
} //end servo0graus

void servo90graus()             //Posiciona o servo em 90 graus
{
  digitalWrite(servo1, HIGH);  //pulso do servo
  delayMicroseconds(1500);     //1.5ms
  digitalWrite(servo1, LOW);   //completa periodo do servo
  for (int i = 0; i < 12; i++)delayMicroseconds(1500);
  // 20ms = 20000us
  // 20000us - 1500us = 18500us
  // 18500/1500 = ~~12
} //end servo0graus

void servo180graus()             //Posiciona o servo em 180 graus
{
  digitalWrite(servo1, HIGH);  //pulso do servo
  delayMicroseconds(2400);     //2.4ms
  digitalWrite(servo1, LOW);   //completa periodo do servo
  for (int i = 0; i < 7; i++)delayMicroseconds(2400);
  // 20ms = 20000us
  // 20000us - 2400us = 17600us
  // 17600/2400 = ~~7
} //end servo0graus
